#include <SPI.h>
#include <Wire.h>
#include <Adafruit_GFX.h>
#include <Adafruit_SSD1306.h>

#define SCREEN_WIDTH 128
#define SCREEN_HEIGHT 64
#define OLED_RESET -1
#define pi 3.1415926535897932384626433832795

Adafruit_SSD1306 display(SCREEN_WIDTH, SCREEN_HEIGHT, &Wire, OLED_RESET);

const unsigned char logo_ssd [] PROGMEM = {
	0x00, 0x00, 0x00, 0x00, 0x00, 0x00, 0x00, 0x00, 0x00, 0x00, 0x00, 0x00, 0x00, 0x00, 0x00, 0x00, 
	0x00, 0x00, 0x00, 0x00, 0x00, 0x00, 0x00, 0x00, 0x00, 0x00, 0x00, 0x00, 0x00, 0x00, 0x00, 0x00, 
	0x00, 0x00, 0x00, 0x00, 0x00, 0x00, 0x00, 0x00, 0x00, 0x00, 0x00, 0x00, 0x00, 0x00, 0x00, 0x00, 
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	0x00, 0x00, 0x00, 0x00, 0x00, 0x00, 0x00, 0x00, 0x00, 0x00, 0x00, 0x00, 0x00, 0x00, 0x00, 0x00
};

float angle_deg, angle_aux, angle_rad, x, y, light_x, light_y, m, module;
int ponto_x = 64, ponto_y = 32, up, down, left, right;

void setup(){

	pinMode(A4, INPUT);
    pinMode(A5, INPUT);
    pinMode(A2, INPUT);
    pinMode(A3, INPUT);
    Serial.begin(9600);

    display.begin(SSD1306_SWITCHCAPVCC, 0x3C);
    display.clearDisplay();
    display.drawBitmap(0, 0, logo_ssd, SCREEN_WIDTH, SCREEN_HEIGHT, WHITE);
    display.display();
    delay(2000);
    display.clearDisplay();
    display.display();

}

void loop(){

	down = analogRead(A1);
    up = analogRead(A0);
    left = analogRead(A3);
    right = analogRead(A2);

/* 	Serial.println("nice");
	Serial.println(right-left);

	module = sqrt(abs(up-down)*abs(up-down) + abs(right-left)*abs(right-left)); */

	light_y = up - down;
    light_x = right - left;

    m = light_y / light_x;

	//atan2 para evitar if's
    angle_deg = atan(m);
    angle_deg = (angle_deg * 180) / pi;

    if(light_x>0 && light_y>0){
        angle_deg = angle_deg;
    }
    else if(light_x<0 && light_y<0){
        angle_deg = angle_deg + 180;
    }
    else if(light_x>0 && light_y<0){
        angle_deg = angle_deg + 360;
    }
    else if(light_x<0 && light_y>0){
        angle_deg = angle_deg + 180;
    }

	display.setCursor(92,0);
	display.setTextSize(1);
	display.setTextColor(WHITE);
	display.print("up:");
	display.print(up);
	display.setCursor(0,0);
	display.print("left:");
	display.print(left);
	display.setCursor(0,57);
	display.print("down:");
	display.print(down);
	display.setCursor(74,57);
	display.print("right:");
	display.print(module);

	if(angle_deg >= 0 && angle_deg < 90){

		angle_rad = (angle_deg * pi) / 180;

		x = ponto_x + (25*cos(angle_rad));
		y = ponto_y - (25*sin(angle_rad));
		
		display.drawLine(ponto_x, ponto_y, x, y, WHITE);
		display.drawCircle(x, y, 4, WHITE);

		x = ponto_x - (25*cos(angle_rad));
		y = ponto_y + (25*sin(angle_rad));

		display.drawLine(ponto_x, ponto_y, x, y, WHITE);

		display.display();
	}
	else if(angle_deg >= 90 && angle_deg < 180){

		angle_aux = 180-angle_deg;

		angle_rad = (angle_aux * pi) / 180;

		x = ponto_x - (25*cos(angle_rad));
		y = ponto_y - (25*sin(angle_rad));

		display.drawLine(ponto_x, ponto_y, x, y, WHITE);
		display.drawCircle(x, y, 4, WHITE);

		x = ponto_x + (25*cos(angle_rad));
		y = ponto_y + (25*sin(angle_rad));

		display.drawLine(ponto_x, ponto_y, x, y, WHITE);

		display.display();
	}
	else if(angle_deg >= 180 && angle_deg < 270){

		angle_aux = angle_deg - 180;

		angle_rad = (angle_aux * pi) / 180;

		x = ponto_x - (25*cos(angle_rad));
		y = ponto_y + (25*sin(angle_rad));

		display.drawLine(ponto_x, ponto_y, x, y, WHITE);
		display.drawCircle(x, y, 4, WHITE);

		x = ponto_x + (25*cos(angle_rad));
		y = ponto_y - (25*sin(angle_rad));

		display.drawLine(ponto_x, ponto_y, x, y, WHITE);

		display.display();

	}
	else if(angle_deg >= 270 && angle_deg < 360){
		
		angle_aux = 360 - angle_deg;

		angle_rad = (angle_aux * pi) / 180;

		x = ponto_x + (25*cos(angle_rad));
		y = ponto_y + (25*sin(angle_rad));

		display.drawLine(ponto_x, ponto_y, x, y, WHITE);
		display.drawCircle(x, y, 4, WHITE);

		x = ponto_x - (25*cos(angle_rad));
		y = ponto_y - (25*sin(angle_rad));

		display.drawLine(ponto_x, ponto_y, x, y, WHITE);

		display.display();
	}

	display.clearDisplay();

}