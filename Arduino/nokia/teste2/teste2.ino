#include <SPI.h>
#include <Adafruit_GFX.h>
#include <Adafruit_PCD8544.h>
//#include <avr/pgmspace.h>

// Display
// GND   - GND
// 3,3 V - VCC
// pin 7 - Serial clock out (SCLK)
// pin 6 - Serial data out (DIN)
// pin 5 - Data/Command select (D/C)
// pin 4 - LCD chip select (CS)
// pin 3 - LCD reset (RST)
// pin 8 - LED

//Buttons
// pin 9 - Down Button
// pin 10 - Middle Button
// pin 11 - Up Button

// Light sensor
// 5V
// 10k ohm GND // pin A0

// Temperature sensor
// 5V - VCC
// pin A1 - middle
// GND - GND

// Ultrasound sensor
// 5V - VCC
// pin 12 - Trig
// pin 2 - Echo
// GND - GND

const unsigned char logo_nokia [] PROGMEM = {
	0x00, 0x00, 0x00, 0x00, 0x00, 0x00, 0x00, 0x00, 0x00, 0x00, 0x00, 0x00, 0x00, 0x00, 0x00, 0x00, 
	0x00, 0x00, 0x00, 0x00, 0x00, 0x00, 0x00, 0x00, 0x00, 0x00, 0x00, 0x00, 0x00, 0x00, 0x00, 0x00, 
	0x00, 0x00, 0x00, 0x00, 0x00, 0x00, 0x00, 0x00, 0x00, 0x00, 0x00, 0x00, 0x00, 0x00, 0x00, 0x00, 
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	0x00, 0x00, 0x00, 0x00, 0x00, 0x00, 0x00, 0x00, 0x00, 0x00, 0x00, 0x00, 0x00, 0x00, 0x00, 0x00
};

Adafruit_PCD8544 display = Adafruit_PCD8544(7, 6, 5, 4, 3);

int contrast = 65;

volatile boolean up = false;
volatile boolean down = false;
volatile boolean middle = false;

int downButtonState = 0;
int upButtonState = 0;  
int selectButtonState = 0;   
int stateButtonState = 0;       
int lastDownButtonState = 0;
int lastSelectButtonState = 0;
int lastUpButtonState = 0;
int light;
float temp;
float duration;
int trig = 12;
int echo = 2;


int page = 1;
int menuItem = 1;


void setup(){

	pinMode(8, OUTPUT);
	pinMode(9, INPUT_PULLUP);
	pinMode(10, INPUT_PULLUP);
	pinMode(11, INPUT_PULLUP);
	pinMode(12, INPUT_PULLUP);
	pinMode(echo, INPUT);
	pinMode(trig, OUTPUT);

	digitalWrite(8, HIGH);

	Serial.begin(9600);

	DrawLogo();
}

void loop(){

	DrawMenu();

	downButtonState = digitalRead(9);
  	selectButtonState = digitalRead(10);
  	upButtonState =   digitalRead(11);
	
	checkDownButton();
	checkSelectButton();
	checkUpButton();

	if(up && page == 1){
		up = false;
		menuItem--;
		
		if(menuItem == 0){
			menuItem = 3;
		}
	}

	if(down && page == 1){
		down = false;
		menuItem++;

		if(menuItem == 4){
			menuItem = 1;
		}
	}

	if(middle){
		middle= false;

		if(page==1 && menuItem==1){
			page = 2;
		}
		else if(page == 1 && menuItem == 2){
			page = 3;
		}
		else if(page == 1 && menuItem == 3){
			page = 4;
		}
		else if(page == 2 || page == 3 || page == 4){
			page = 1;
		}
	}

}

void DrawLogo(){
	
	display.begin();
	display.setContrast(contrast);
	display.clearDisplay();
	display.display();
	display.drawBitmap(0, 0, logo_nokia, 84, 48, BLACK);
	display.display();
	delay(2000);
	display.clearDisplay();
	display.display();
}

void DrawMenu(){

	if(page == 1){
		display.setTextSize(1);
    	display.clearDisplay();
    	display.setTextColor(BLACK, WHITE);
    	display.setCursor(15, 0);
    	display.print("MAIN MENU");
    	display.drawFastHLine(0,10,83,BLACK);
    	display.setCursor(0, 15);

		if(menuItem == 1){
			display.setTextColor(WHITE, BLACK);
		}
		else{
			display.setTextColor(BLACK, WHITE);
		}
		display.print(">Temperature");
		display.setCursor(0, 25);

		if(menuItem == 2){
			display.setTextColor(WHITE, BLACK);
		}
		else{
			display.setTextColor(BLACK, WHITE);
		}
		display.print(">Light");
		display.setCursor(0, 35);

		if(menuItem == 3){
			display.setTextColor(WHITE, BLACK);
		}
		else{
			display.setTextColor(BLACK, WHITE);
		}
		display.print(">Distance");

		display.display();
	}
	else if(page == 2){

		display.clearDisplay();
		display.setTextColor(BLACK, WHITE);
		display.setTextSize(1);
		display.setCursor(8,0);
		display.print("TEMPERATURE");
		display.drawFastHLine(0, 10, 83, BLACK);
		display.setCursor(5, 15);
		temp = analogRead(A1);

		temp = ((temp*5)/1023)*100;

		display.print(temp);
		display.print("'C");
		display.display();

	}
	else if(page == 3){

		display.clearDisplay();
		display.setTextColor(BLACK, WHITE);
		display.setTextSize(1);
		display.setCursor(27,0);
		display.print("LIGHT");
		display.drawFastHLine(0, 10, 83, BLACK);
		display.setCursor(5, 15);
		
		light = analogRead(A0);
		display.print(light);
		display.display();
		//delay(500);
	}
	else if(page == 4){
		display.clearDisplay();
		display.setTextColor(BLACK, WHITE);
		display.setTextSize(1);
		display.setCursor(15,0);
		display.print("DISTANCE");
		display.drawFastHLine(0, 10, 83, BLACK);
		display.setCursor(5, 15);

		digitalWrite(trig, LOW);
		delayMicroseconds(2);
		digitalWrite(trig, HIGH);
  		delayMicroseconds(10);
  		digitalWrite(trig, LOW);
		duration = pulseIn(echo, HIGH);
		duration = (duration * 0.034) / 2;

		display.print(duration);
		display.print(" cm");
		display.display();
	}

}

void checkDownButton(){

	if(downButtonState != lastDownButtonState){
		if(downButtonState == 0){
			down = true;
		}
		delay(50);
	}
	lastDownButtonState = downButtonState;
}

void checkSelectButton(){

	if(selectButtonState != lastSelectButtonState){
		if(selectButtonState == 0){
			middle = true;
		}
		delay(50);
	}
	lastSelectButtonState = selectButtonState;
}

void checkUpButton(){

	if(upButtonState != lastUpButtonState){
		if(upButtonState == 0){
			up = true;
		}
		delay(50);
	}
	lastUpButtonState = upButtonState;
}