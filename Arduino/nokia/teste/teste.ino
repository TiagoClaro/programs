

#include <SPI.h>
#include <Adafruit_GFX.h>
#include <Adafruit_PCD8544.h>
#define contrast 60
#define selectButton 9
#define downButton 10

// Display
// GND   - GND
// 3,3 V - VCC
// pin 7 - Serial clock out (SCLK)
// pin 6 - Serial data out (DIN)
// pin 5 - Data/Command select (D/C)
// pin 4 - LCD chip select (CS)
// pin 3 - LCD reset (RST)
// pin 8 - LED

const unsigned char setaBaixo [] PROGMEM = {
	0x00, 0x00, 0x00, 0x00, 0x00, 0x00, 0x00, 0x00, 0x00, 0x00, 0x00, 0x00, 0x00, 0x00, 0x00, 0x00, 
	0x00, 0x00, 0x00, 0x00, 0x00, 0x00, 0x00, 0x00, 0x00, 0x00, 0x00, 0x00, 0x00, 0x00, 0x00, 0x00, 
	0x00, 0x00, 0x00, 0x00, 0x00, 0x00, 0x00, 0x00, 0x00, 0x00, 0x00, 0x00, 0x00, 0x00, 0x00, 0x00, 
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	0x00, 0x00, 0x00, 0x00, 0x00, 0x00, 0x00, 0x00, 0x00, 0x00, 0x00, 0x00, 0x00, 0x00, 0x00, 0x00
};

const unsigned char setaCima [] PROGMEM = {
	0x00, 0x00, 0x00, 0x00, 0x00, 0x00, 0x00, 0x00, 0x00, 0x00, 0x00, 0x00, 0x00, 0x00, 0x00, 0x00, 
	0x00, 0x00, 0x00, 0x00, 0x00, 0x00, 0x00, 0x00, 0x00, 0x00, 0x00, 0x00, 0x00, 0x00, 0x00, 0x00, 
	0x00, 0x00, 0x00, 0x00, 0x00, 0x00, 0x00, 0x00, 0x00, 0x00, 0x00, 0x00, 0x00, 0x00, 0x00, 0x00, 
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	0x00, 0x00, 0x00, 0x00, 0x00, 0x00, 0x00, 0x00, 0x00, 0x00, 0x00, 0x00, 0x00, 0x00, 0x00, 0x00
};

const unsigned char logo_nokia [] PROGMEM = {
	0x00, 0x00, 0x00, 0x00, 0x00, 0x00, 0x00, 0x00, 0x00, 0x00, 0x00, 0x00, 0x00, 0x00, 0x00, 0x00, 
	0x00, 0x00, 0x00, 0x00, 0x00, 0x00, 0x00, 0x00, 0x00, 0x00, 0x00, 0x00, 0x00, 0x00, 0x00, 0x00, 
	0x00, 0x00, 0x00, 0x00, 0x00, 0x00, 0x00, 0x00, 0x00, 0x00, 0x00, 0x00, 0x00, 0x00, 0x00, 0x00, 
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	0x00, 0x00, 0x00, 0x00, 0x00, 0x00, 0x00, 0x00, 0x00, 0x00, 0x00, 0x00, 0x00, 0x00, 0x00, 0x00
};

Adafruit_PCD8544 display = Adafruit_PCD8544(7, 6, 5, 4, 3);

int page = 1;
int menuItem = 1;

int downButtonState = 0;
int selectButtonState = 0;   
int lastDownButtonState = 0;
int lastSelectButtonState = 0;

volatile boolean down = false;
volatile boolean select = false;

int upLight = 112;
int downLight = 111;

void setup(){

	pinMode(9, INPUT_PULLUP);
	pinMode(10, INPUT_PULLUP);

	pinMode(8, OUTPUT);
	digitalWrite(8, HIGH);

	Serial.begin(9600);

	display.begin();
	display.setContrast(contrast);
	display.clearDisplay();
	display.display();

}

void loop(){

	drawMenu();

	downButtonState = digitalRead(10);
	selectButtonState = digitalRead(9);

	checkDownButton();
	checkSelectButton();

	if(down && page == 2){
		down = false;
		menuItem++;

		if(menuItem == 4){
			menuItem = 1;
		}
	}

	if(select && page == 1){
		page == 2;
	}

	if(select && page == 2){

		if(menuItem == 1){
			page == 3;
		}
		else if(menuItem == 2){
			page == 4;
		}
		else if(menuItem == 3){
			page == 1;
		}
	}
}


void drawMenu(){

	if(page == 1){
		display.drawBitmap(0, 0, logo_nokia, 84, 48, BLACK);
	}
	
	else if(page == 2){
		display.setTextSize(1);
		display.clearDisplay();
		display.setTextColor(BLACK, WHITE);
		display.setCursor(7, 0);
		display.print("LIGHT SENSOR");
		display.drawFastHLine(0, 10, 83, BLACK);
		display.setCursor(0,15);

		if(menuItem == 1){
			display.setTextColor(WHITE, BLACK);
		}
		else{
			display.setTextColor(BLACK, WHITE);
		}
		display.print("-> Light Value");
		display.setCursor(0,25);

		if(menuItem == 2){
			display.setTextColor(WHITE, BLACK);
		}
		else{
			display.setTextColor(BLACK, WHITE);
		}
		display.print("-> Light Map");
		display.setCursor(0, 35);

		if(menuItem == 3){
			display.setTextColor(WHITE, BLACK);
		}
		else{
			display.setTextColor(BLACK, WHITE);
		}
		display.print("-> Home");
	}

	else if(page == 3){
		
		display.setTextSize(1);
		display.clearDisplay();
		display.setTextColor(BLACK, WHITE);
		display.setCursor(7, 0);
		display.print("LIGHT VALUE");
		display.drawFastHLine(0, 10, 83, BLACK);
		display.setCursor(0,15);
		display.print("Up Light:");
		display.print(upLight);
		display.setCursor(0, 30);
		display.print("Down Light:");
		display.print(downLight);
	}

	else if(page == 4){

		if(upLight > downLight){
			display.drawBitmap(0, 0, setaCima, 84, 48, BLACK);
		}
		else if(downLight > upLight){
			display.drawBitmap(0, 0, setaBaixo, 84, 48, BLACK);
		}
		else{
			display.setCursor(0,0);
			display.println("Matching");
			display.print("lights");
		}
	}

	display.display();
}

void checkDownButton(){

	if(downButtonState != lastDownButtonState){
		if(downButtonState == 0){
			down = true;
		}
		delay(50);
	}
	lastDownButtonState = downButtonState;
}

void checkSelectButton(){

	if(selectButtonState != lastSelectButtonState){
		if(selectButtonState == 0){
			select = true;
		}
		delay(50);
	}
	lastSelectButtonState = selectButtonState;
}

